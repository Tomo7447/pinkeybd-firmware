## config/west.yml
```yaml
manifest:
  remotes:
    - name: zmkfirmware
      url-base: https://github.com/zmkfirmware
    - name: ktkhshi
      url-base: https://github.com/ktkhshi

  projects:
    - name: zmk
      remote: zmkfirmware
      revision: v0.3
      import: app/west.yml

    # 追加モジュールがあるならここに残す（あなたの構成に合わせて残してOK）
    - name: zmk-pmw3610-driver
      remote: ktkhshi
      revision: main

  self:
    west-commands: scripts/west-commands.yml
```
